## components/improv/Kconfig.projbuild
```kconfig
menu "Improv Serial"

config ENABLE_IMPROV_SERIAL
    bool "Enable Improv Serial provisioning"
    default y
    help
        Adds the Improv Serial protocol (https://www.improv-wifi.com/serial/)
        so first-time Wi-Fi provisioning can be done from the same tab as the
        web flasher: ESP Web Tools flashes the firmware, then prompts for
        SSID / password and pushes them over the same USB serial connection.

        When enabled and no Wi-Fi credentials are stored, Improv becomes the
        sole Serial RX consumer for that boot -- the HomeSpan console "press
        any key" trigger is suppressed to avoid a second reader. After a
        successful association the credentials are persisted via HomeSpan's
        public API and setup continues in-process (no reboot); Improv
        remains the sole Serial RX consumer for the rest of this boot.

        The existing captive-portal / config-AP flow is unchanged and remains
        the reprovisioning path once credentials are stored.

        Default y: this is the intended provisioning experience. Disable it
        only if the firmware is too tight on flash (this component adds a
        few kilobytes) or if the console must stay usable when the device is
        unprovisioned.

endmenu
```

## main/Kconfig.projbuild
```kconfig
menu "Arduino subsystem serial logging"
  config ARDUINO_USE_USB_JTAG
    depends on !IDF_TARGET_ESP32
    bool "Output serial log via the USB/JTAG controller"
    default n
  config INIT_ARDU_SERIAL_LOGGING
    bool "Initialize serial logging for the Arduino subsystem and by extent for HomeSpan"
    default y
endmenu

menu "Installer variant defaults"
  config INSTALLER_ATOMS3_LITE_DEFAULTS
    depends on IDF_TARGET_ESP32S3
    bool "M5Stack AtomS3 Lite installer defaults (ST25R3916 on Grove)"
    default n
    help
      Set only for the Pages web-flasher factory image. When enabled, the
      firmware's compile-time NFC defaults change to reader type 2 (ST25R3916,
      I2C) using the "AtomS3 Lite + Unit NFC" pin preset (SDA=G2, SCL=G1).
      Existing persisted NVS still wins on non-factory upgrades, so this is
      safe to enable per build variant without disturbing already-provisioned
      devices that reflash later. Do not enable for the generic firmware.
endmenu
```
